## kernel/linux/arch/mips/brcm-boards/bcm963xx/Kconfig
```kconfig
# Kernel and Driver configuration for Broadcom Commengine ADSL board
choice
	prompt "Broadcom Commengine ADSL board"
	depends on MIPS_BRCM
	default BCM96348
	help
	  Select different Broadcom ADSL board

config BCM96338
	bool "96338 ADSL board"
	select DMA_NONCOHERENT

config BCM96348
	bool "96348 ADSL board"
	select DMA_NONCOHERENT

config BCM96358
	bool "96358 ADSL board"
	select DMA_NONCOHERENT

endchoice

config BCM_BOARD
	bool "Support for Broadcom Board"
	depends on BCM96338 || BCM96348 || BCM96358

config BCM_SERIAL
	bool "Support for Serial Port"
	depends on BCM96338 || BCM96348 || BCM96358

config BCM_ENET
	tristate "Support for Ethernet"
	depends on BCM96338 || BCM96348 || BCM96358

config BCM_USB
	tristate "Support for USB"
	depends on BCM96338 || BCM96348 || BCM96358

config BCM_WLAN
	tristate "Support for Wireless"
	depends on BCM96338 || BCM96348 || BCM96358

config BCM_PCI
	bool "Support for PCI"
	depends on BCM96338 || BCM96348 || BCM96358
	select PCI

config BCM_ATMAPI
	tristate "Support for ATM"
	depends on BCM96338 || BCM96348 || BCM96358

config BCM_ATMTEST
	tristate "Support for ATM Diagnostic"
	depends on BCM96338 || BCM96348 || BCM96358

config BCM_ADSL
	tristate "Support for ADSL"
	depends on BCM96338 || BCM96348 || BCM96358

config BCM_ENDPOINT
	tristate "Support for VOICE"
	depends on BCM96338 || BCM96348 || BCM96358

config BCM_BCMPROF
	tristate "Support for profiling"
	depends on BCM96338 || BCM96348 || BCM96358

config BCM_BCMDSP
	tristate "Support for DSP application"
	depends on BCM96338 || BCM96348 || BCM96358
config BCM_PROCFS
	tristate "Support for PROCFS"
	depends on BCM96338 || BCM96348 || BCM96358

config BCM_VDSL
	tristate "Support for VDSL"
	depends on BCM96338 || BCM96348 || BCM96358

config KPN_QOS
	tristate "Support for KPN QOS"
	depends on BCM96338 || BCM96348 || BCM96358

config TDE_QOS
	tristate "Support for TDE QOS"
	depends on BCM96338 || BCM96348 || BCM96358


config ETHWAN
	tristate "Support for ETHWAN"
	depends on BCM96338 || BCM96348 || BCM96358


config LSWWAN
	tristate "Support for LSWWAN"
	depends on BCM96338 || BCM96348 || BCM96358
config KPN_VLAN
	tristate "Support for KPN VLAN"
	depends on BCM96338 || BCM96348 || BCM96358	
	
config WLAN_REVERSE_PRESS_RESET_KEY
	tristate "Support for WLAN_REVERSE_PRESS_RESET_KEY"
	depends on BCM96338 || BCM96348 || BCM96358	

config SLIC_3210
	tristate "Support for SLIC_3210"
	depends on BCM96338 || BCM96348 || BCM96358	
	
config SLIC_3215
	tristate "Support for SLIC_3215"
	depends on BCM96338 || BCM96348 || BCM96358	

config SLIC_LE88221
	tristate "Support for SLIC_88221"
	depends on BCM96338 || BCM96348 || BCM96358	
			
config FXO_REINJECTION
	tristate "Support for FXO_REINJECTION"
	depends on BCM96338 || BCM96348 || BCM96358	
				
config BCM_SECURITY
	tristate "Support for SECURITY"
	depends on BCM96338 || BCM96348 || BCM96358

config BCM_HPNA
	tristate "Support for HPNA"
	depends on BCM96338 || BCM96348 || BCM96358

config BCM_BOARD_IMPL
	int "Implementation index for ADSL Board"
	depends on BCM96338 || BCM96348 || BCM96358

config BCM_SERIAL_IMPL
	int "Implementation index for Serial"
	depends on BCM96338 || BCM96348 || BCM96358

config BCM_ENET_IMPL
	int "Implementation index for Ethernet"
	depends on BCM96338 || BCM96348 || BCM96358

config BCM_USB_IMPL
	int "Implementation index for USB"
	depends on BCM96338 || BCM96348 || BCM96358

config BCM_WLAN_IMPL
	int "Implementation index for WIRELESS"
	depends on BCM96338 || BCM96348 || BCM96358

config BCM_ATMAPI_IMPL
	int "Implementation index for ATM"
	depends on BCM96338 || BCM96348 || BCM96358

config BCM_ATMTEST_IMPL
	int "Implementation index for ATM Diagnostic"
	depends on BCM96338 || BCM96348 || BCM96358

config BCM_BLAA_IMPL
	int "Implementation index for BLAA"
	depends on BCM96338 || BCM96348 || BCM96358

config BCM_ADSL_IMPL
	int "Implementation index for ADSL"
	depends on BCM96338 || BCM96348 || BCM96358

config BCM_ENDPOINT_IMPL
	int "Implementation index for VOICE"
	depends on BCM96338 || BCM96348 || BCM96358

config BCM_BCMPROF_IMPL
	int "Implementation index for PROFILING"
	depends on BCM96338 || BCM96348 || BCM96358
config BCM_BCMDSP_IMPL
	int "Implementation index for PROFILING"
	depends on BCM96338 || BCM96348 || BCM96358
config BCM_PROCFS_IMPL
	int "Implementation index for PROCFS"
	depends on BCM96338 || BCM96348 || BCM96358

config BCM_VDSL_IMPL
	int "Implementation index for VDSL"
	depends on BCM96338 || BCM96348 || BCM96358

config BCM_SECURITY_IMPL
	int "Implementation index for SECURITY"
	depends on BCM96338 || BCM96348 || BCM96358

config BCM_HPNA_IMPL
	int "Implementation index for HPNA"
	depends on BCM96338 || BCM96348 || BCM96358

choice
	prompt "Root File System"
	depends on MIPS_BRCM
	default ROOTFS_SQUASHFS
	help
	  Select root file system on the board flash. 

config ROOTFS_SQUASHFS
        bool "SQUASHFS"
config ROOTFS_CRAMFS
        bool "CRAMFS"
config ROOTFS_JFFS2
        bool "JFFS2"
config ROOTFS_NFS
        bool "NFS"

endchoice

config ROOT_FLASHFS
	string "flash partition"
	depends on ROOTFS_SQUASHFS || ROOTFS_CRAMFS || ROOTFS_JFFS2
	default "root=31:0 ro noinitrd" if ROOTFS_SQUASHFS = y || ROOTFS_CRAMFS = y
	default "root=31:2 ro noinitrd" if ROOTFS_JFFS2 = y
	help
	  This is the root file system partition on flash memory

config ROOT_NFS_DIR
	string "NFS server path"
	depends on ROOTFS_NFS
	default "/opt/bcm96338/targets/96338R/fs" if BCM96338 = y
	default "/opt/bcm96348/targets/96348R/fs" if BCM96348 = y  
	default "/opt/bcm96358/targets/96358R/fs" if BCM96358 = y  
	help
	  This is the path of NFS server (host system)
```
